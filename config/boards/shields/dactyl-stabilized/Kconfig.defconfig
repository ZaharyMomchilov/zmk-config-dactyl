## config/boards/shields/dactyl-stabilized/Kconfig.defconfig
```kconfig
if SHIELD_DACTYL_STABILIZED_LEFT

config ZMK_KEYBOARD_NAME
    default "dstab-left"

config ZMK_SPLIT_BLE_ROLE_CENTRAL
    default y

config ZMK_SPLIT_BLE_ROLE_PERIPHERAL
    default n

endif

if SHIELD_DACTYL_STABILIZED_RIGHT

config ZMK_KEYBOARD_NAME
    default "dstab-right"

config ZMK_SPLIT_BLE_ROLE_PERIPHERAL
    default y

config ZMK_SPLIT_BLE_ROLE_CENTRAL
    default n

endif

if SHIELD_DACTYL_STABILIZED_LEFT || SHIELD_DACTYL_STABILIZED_RIGHT

config ZMK_SPLIT
    default y

endif
```
